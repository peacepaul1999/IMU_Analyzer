## main/Kconfig
```kconfig
menu "IMU Options"
config ENABLE_IMU_RAW_LOG
    bool "Enable IMU raw debug logs"
    default n
config ENABLE_I2C_SCAN
    bool "Enable I2C scan at startup"
    default n
config ENABLE_I2C_RECOVERY
    bool "Enable I2C bus recovery"
    default n
endmenu
```

## sdkconfig.defaults
```kconfig
CONFIG_IDF_TARGET="esp32s3"
CONFIG_FREERTOS_HZ=1000
CONFIG_LOG_DEFAULT_LEVEL_INFO=y
CONFIG_HTTPD_WS_SUPPORT=y
CONFIG_ESPTOOLPY_FLASHSIZE_8MB=y
```
